&mdss_mdp {
	dsi_ft8720m_xinli_v2_video: qcom,mdss_dsi_ft8720m_xinli_v2_video {
		qcom,mdss-dsi-panel-name = "ft8720m v2 video mode dsi xinli panel";
		qcom,mdss-dsi-panel-type = "dsi_video_mode";
		qcom,dsi-ctrl-num = <0x00>;
		qcom,dsi-phy-num = <0x00>;
		qcom,mdss-dsi-virtual-channel-id = <0x00>;
		qcom,mdss-dsi-stream = <0x00>;
		qcom,mdss-dsi-h-left-border = <0x00>;
		qcom,mdss-dsi-h-right-border = <0x00>;
		qcom,mdss-dsi-v-top-border = <0x00>;
		qcom,mdss-dsi-v-bottom-border = <0x00>;
		qcom,mdss-dsi-bpp = <0x18>;
		qcom,mdss-dsi-color-order = "rgb_swap_rgb";
		qcom,mdss-dsi-underflow-color = <0xff>;
		qcom,mdss-dsi-border-color = <0x00>;
		qcom,mdss-dsi-h-sync-pulse = <0x00>;
		qcom,mdss-dsi-traffic-mode = "non_burst_sync_event";
		qcom,mdss-dsi-lane-map = "lane_map_0123";
		qcom,mdss-dsi-bllp-eof-power-mode;
		qcom,mdss-dsi-bllp-power-mode;
		qcom,mdss-dsi-tx-eot-append;
		qcom,mdss-dsi-lane-0-state;
		qcom,mdss-dsi-lane-1-state;
		qcom,mdss-dsi-lane-2-state;
		qcom,mdss-dsi-lane-3-state;
		qcom,mdss-dsi-dma-trigger = "trigger_sw";
		qcom,mdss-dsi-mdp-trigger = "none";
		qcom,mdss-dsi-lp11-init;
		qcom,mdss-dsi-reset-sequence = <0x01 0x05 0x00 0x02 0x01 0x14>;
		qcom,mdss-pan-physical-width-dimension = <0x41>;
		qcom,mdss-pan-physical-height-dimension = <0x81>;
		qcom,mdss-dsi-te-pin-select = <0x01>;
		qcom,mdss-dsi-wr-mem-start = <0x2c>;
		qcom,mdss-dsi-wr-mem-continue = <0x3c>;
		qcom,mdss-dsi-te-dcs-command = <0x01>;
		qcom,mdss-dsi-te-check-enable;
		qcom,mdss-dsi-te-using-te-pin;
		qcom,mdss-dsi-t-clk-post = <0x0e>;
		qcom,mdss-dsi-t-clk-pre = <0x35>;
		qcom,esd-check-enabled;
		qcom,platform-reset-gpio-always-on;
		qcom,mdss-dsi-panel-status-check-mode = "reg_read";
		qcom,mdss-dsi-panel-status-command = <0x6010001 0x10a>;
		qcom,mdss-dsi-panel-status-command-state = "dsi_lp_mode";
		qcom,mdss-dsi-panel-status-value = <0x9c>;
		qcom,mdss-dsi-panel-status-read-length = <0x01>;
		qcom,mdss-dsi-panel-max-error-count = <0x03>;
		qcom,mdss-dsi-panel-framerate = <0x3c>;
		qcom,dsi-supported-dfps-list = <0x3c 0x37 0x30>;
		qcom,mdss-dsi-pan-fps-update = "dfps_immediate_porch_mode_vfp";
		qcom,dsi-select-clocks = "mux_byte_clk0", "mux_pixel_clk0", "src_byte_clk0", "src_pixel_clk0", "shadow_byte_clk0", "shadow_pixel_clk0";
		qcom,dsi-dyn-clk-list = <0x3a2f7bc0 0x3ae9ad50 0x3aab9cc8 0x3a6d8c48>;
		qcom,dsi-dyn-clk-type = "constant-fps-adjust-vfp";
		qcom,panel-supply-entries = <0x0d>;
		qcom,mdss-dsi-bl-pmic-control-type = "bl_ctrl_pwm";
		pwms = <&pm6125_pwm 0x00 0x00>;
		qcom,bl-pmic-pwm-period-usecs = <0x64>;
		qcom,mdss-dsi-bl-min-level = <0x01>;
		qcom,mdss-dsi-bl-max-level = <0xfff>;
		qcom,mdss-brightness-max-level = <0xfff>;
		qcom,platform-reset-gpio = <&tlmm 0x55 0x00>;
		qcom,platform-bklight-en-gpio = <&tlmm 0x63 0x00>;
		phandle = <0x13>;

		qcom,mdss-dsi-display-timings {

			timing@0 {
			qcom,mdss-dsi-panel-width = <0x438>;
			qcom,mdss-dsi-panel-height = <0x924>;
			qcom,mdss-dsi-h-front-porch = <0x4c>;
			qcom,mdss-dsi-h-back-porch = <0x38>;
			qcom,mdss-dsi-h-pulse-width = <0x0c>;
			qcom,mdss-dsi-h-sync-skew = <0x00>;
			qcom,mdss-dsi-v-back-porch = <0x12>;
			qcom,mdss-dsi-v-front-porch = <0x46>;
			qcom,mdss-dsi-v-pulse-width = <0x02>;
			qcom,mdss-dsi-panel-framerate = <0x3c>;
			qcom,mdss-dsi-on-command = [39 01 00 00 00 00 02 00 00 39 01 00 00 00 00 04 ff 87 20 01 39 01 00 00 00 00 02 00 80 39 01 00 00 00 00 03 ff 87 20 39 01 00 00 00 00 02 00 b0 39 01 00 00 00 00 02 ca 00 39 01 00 00 00 00 02 00 b2 39 01 00 00 00 00 02 ca 0c 39 01 00 00 00 00 02 00 b5 39 01 00 00 00 00 02 ca 06 39 01 00 00 00 00 02 00 00 39 01 00 00 00 00 02 1c 02 39 01 00 00 00 00 02 35 00 39 01 00 00 00 00 03 51 ff 0f 39 01 00 00 00 00 02 53 2c 39 01 00 00 00 00 02 55 00 05 01 00 00 96 00 02 11 00 05 01 00 00 32 00 02 29 00];
			qcom,mdss-dsi-off-command = [05 01 00 00 14 00 02 28 00 05 01 00 00 8c 00 02 10 00 39 01 00 00 00 00 02 00 00 39 01 00 00 05 00 05 f7 5a a5 95 27];
			qcom,mdss-dsi-cabc-on-command = [39 01 00 00 00 00 02 55 01];
			qcom,mdss-dsi-cabc-off-command = [39 01 00 00 00 00 02 55 00];
			qcom,mdss-dsi-cabc_movie-on-command = [39 01 00 00 00 00 02 55 03];
			qcom,mdss-dsi-cabc_still-on-command = [39 01 00 00 00 00 02 55 02];
			qcom,mdss-dsi-on-command-state = "dsi_lp_mode";
			qcom,mdss-dsi-off-command-state = "dsi_lp_mode";
			qcom,mdss-dsi-cabc-on-command-state = "dsi_hs_mode";
			qcom,mdss-dsi-cabc-off-command-state = "dsi_hs_mode";
			qcom,mdss-dsi-cabc_movie-on-command-state = "dsi_hs_mode";
			qcom,mdss-dsi-cabc_still-on-command-state = "dsi_hs_mode";
			qcom,mdss-dsi-panel-phy-timings = <0x2620090a 0x60204a0 0x2620090a 0x60204a0 0x2620090a 0x60204a0 0x2620090a 0x60204a0 0x261f090a 0x60204a0>;
			qcom,display-topology = <0x01 0x00 0x01>;
			qcom,default-topology-index = <0x00>;
			};
		};
	};
};


